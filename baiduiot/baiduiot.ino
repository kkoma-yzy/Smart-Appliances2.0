#include <ESP8266WiFi.h>
#include <PubSubClient.h>
#include <DHT.h>
#include <ArduinoJson.h>
#include <IRremoteESP8266.h>
#include <IRsend.h>
int num;
DHT sensor(D5,DHT11);
IRsend remote(D1);
uint16_t poweron[199] = {4452, 4542,  566, 1630,  590, 562,  564, 1620,  590, 1656,  566, 538,  614,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 1666,  552};  // COOLIX B2BFE4
//uint16_t poweroff[199] = {4452, 4546,  588, 1602,  616, 542,  586, 1604,  614, 1630,  588, 514,  616,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 1660,  562};  // COOLIX B27BE0
uint16_t poweroff[199] = {4550, 4432,  516, 1610,  514, 542,  516, 1608,  516, 1608,  516, 542,  516,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 1610,  514};  // COOLIX B27BE0
uint16_t temp[14][199] = {
                            {4580, 4402,  510, 1616,  510, 546,  510, 1614,  510, 1614,  510, 548,  510,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 1616,  508},
                            {4580, 4402,  510, 1614,  510, 546,  512, 1614,  510, 1612,  512, 546,  510,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 1616,  508},
                            {4580, 4402,  512, 1612,  512, 546,  512, 1614,  510, 1612,  512, 546,  512,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 1616,  508},
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                            {4580, 4402,  510, 1614,  510, 548,  510, 1614,  510, 1614,  510, 546,  510,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 1616,  508},
                         
                         
                         };
WiFiClient tcp;
PubSubClient mqtt(tcp);

const char* wifi_ssid = "OPPO A5";
const char* wifi_passwd = "12345678";
const char* mqtt_server = "qcbgkzv.mqtt.iot.gz.baidubce.com";
const char* mqtt_clientid = "led";
const char* mqtt_user = "qcbgkzv/led";
const char* mqtt_passwd = "v5d0hS0XED1lIYKv";
const char* topic_delta = "$baidu/iot/shadow/led/delta";
const char* topic_update = "$baidu/iot/shadow/led/update";

void mqtt_callback(const char* topic, byte* payload, unsigned int length)
{
  Serial.println(topic);
  if (String(topic) == topic_delta)
  {
    const size_t capacity = JSON_OBJECT_SIZE(2) + JSON_OBJECT_SIZE(3) + JSON_OBJECT_SIZE(5) + 100;
    DynamicJsonDocument doc(capacity);
    deserializeJson(doc, payload, length);

    int  ledswitch = doc["desired"]["ledswitch"];
    int  aircon = doc["desired"]["airpower"]; 
    int  airtemp = doc["desired"]["airtemp"];
    if (ledswitch==1)
    {
      Serial.println("qweqweqweqweqwe");
      digitalWrite(LED_BUILTIN, LOW);
    }
    else if(ledswitch==0);
    else{
      digitalWrite(LED_BUILTIN, HIGH);
    }
    if(aircon==1)
    {
       
       
        remote.sendRaw(poweron, 199, 38);  
        Serial.println("hello");
         remote.sendRaw(temp[0],199,38);
         num=0;
    }
    else if (aircon==0);
    else 
    { Serial.println("world");
      remote.sendRaw(poweroff, 199, 38);
     
    }
   if(airtemp==1)
    {
       
       
          
        Serial.println("jian");
        if(num>0&&num<=13)
        {
          num--;
           remote.sendRaw(temp[num], 199, 38); 
        }
    }
    else if (airtemp==0);
    else 
    { 
      Serial.println("add");
      if(num>=0&&num<13)
      {
        num++;
        remote.sendRaw(temp[num], 199, 38);
      }
      
      
    }
  }
}

void setup() {
  remote.begin();
  Serial.begin(115200);
  Serial.println();
  sensor.begin();
  pinMode(LED_BUILTIN, OUTPUT);
  digitalWrite(LED_BUILTIN, HIGH);

  WiFi.mode(WIFI_STA);
  WiFi.begin(wifi_ssid, wifi_passwd);
  while (!WiFi.isConnected())
  {
    delay(100);
  }
  Serial.println("WiFi is connected");

  mqtt.setServer(mqtt_server, 1883);
  mqtt.setCallback(mqtt_callback);
}

int prev = 0;

void loop() {
  if (!mqtt.connected())
  {
    mqtt.connect(mqtt_clientid, mqtt_user, mqtt_passwd);
    mqtt.subscribe(topic_delta, 1);
    Serial.println("Baidu IoT Hub connected");
  }
  mqtt.loop();
  if (millis() - prev > 30000) //30s上报一次状态
  {
    prev = millis();
    int temp = sensor.readTemperature();
    int humi = sensor.readHumidity();
    const size_t capacity = JSON_OBJECT_SIZE(1) + JSON_OBJECT_SIZE(2);
    DynamicJsonDocument doc(capacity);

    JsonObject reported = doc.createNestedObject("reported");
    reported["temperature"] = temp;
    reported["humidity"] = humi;
    

    String msg;
    serializeJson(doc, msg);
    Serial.println(msg);
    mqtt.publish(topic_update, msg.c_str());
  }
}
